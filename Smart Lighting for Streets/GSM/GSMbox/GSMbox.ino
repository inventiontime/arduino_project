////////////////////////////////////////////////   Include   ///////////////////////////////////////////////////////////////////////////////////////////////////////////////////////////////////////////////////////////////////////////////////////////////////////////////////////////////////
#include <SoftwareSerial.h>
#include <DS1302.h>

////////////////////////////////////////////////   Pins   ///////////////////////////////////////////////////////////////////////////////////////////////////////////////////////////////////////////////////////////////////////////////////////////////////////////////////////////////////
int ampSensor = A0;
int btnPin = 10;
int VCCpin = 11;

////////////////////////////////////////////////   Variables   ///////////////////////////////////////////////////////////////////////////////////////////////////////////////////////////////////////////////////////////////////////////////////////////////////////////////////////////////////
int currentVal;
String sendCMD = "AT+CMGS=\"+919618944678\"";
bool currentBool = true;

////////////////////////////////////////////////   Libraries   ///////////////////////////////////////////////////////////////////////////////////////////////////////////////////////////////////////////////////////////////////////////////////////////////////////////////////////////////////
SoftwareSerial mySerial(12, 13);
DS1302 rtc(2, 3, 4);

////////////////////////////////////////////////   Setup   ///////////////////////////////////////////////////////////////////////////////////////////////////////////////////////////////////////////////////////////////////////////////////////////////////////////////////////////////////
void setup()
{
  pinMode(ampSensor, INPUT);
  pinMode(btnPin, INPUT);
  pinMode(VCCpin, OUTPUT);
  digitalWrite(VCCpin, HIGH);
  
  mySerial.begin(9600);
  Serial.begin(9600);
  
  delay(100);
}

////////////////////////////////////////////////   Loop   ///////////////////////////////////////////////////////////////////////////////////////////////////////////////////////////////////////////////////////////////////////////////////////////////////////////////////////////////////
void loop() {
  if(senseAmp()) {
    Serial.print("LIGHT 001, STREET 1005, AREA \"ROHINI\" NOT FUNCTIONING");
    SendMsg(sendCMD, rtc.getTimeStr(), " LIGHT 001, STREET 1005, AREA \"ROHINI\" NOT FUNCTIONING");
    delay(5000);
  }
  
  if (mySerial.available() > 0)
    Serial.write(mySerial.read());
}

////////////////////////////////////////////////   SendMsg   ///////////////////////////////////////////////////////////////////////////////////////////////////////////////////////////////////////////////////////////////////////////////////////////////////////////////////////////////////
void SendMsg(String sendCmd, String text1, String text2)
{
  mySerial.println("AT+CMGF=1");                  // AT command to set module in SMS mode
  delay(500);
  mySerial.println(sendCmd);                      // AT command for sending SMS
  delay(500);
  mySerial.println(text1 + text2);
  delay(500);
  mySerial.println((char)26);                     // ASCII code of CTRL+Z
  delay(5000);
}

////////////////////////////////////////////////   SenseAmp   ///////////////////////////////////////////////////////////////////////////////////////////////////////////////////////////////////////////////////////////////////////////////////////////////////////////////////////////////////
bool senseAmp()
{
  if(digitalRead(btnPin)) {
    currentVal = analogRead(ampSensor);             // reading the sensor value
    if(abs(currentVal - 510) < 3) {
      currentBool = true;
    } else {
      currentBool = false;
    }
    return currentBool;                              // returning the value
  }
  return false;
}